## src/kernel/Kconfig
```kconfig
config ABK_EBPF_ROOT
	bool "ABK eBPF root PoC"
	depends on BPF && BPF_SYSCALL
	select BPF_LSM
	help
	  Experimental audit-only control plane for an eBPF-assisted root PoC
	  on Android GKI. This exposes grant metadata through /dev without
	  mutating credentials or requiring /system-side helper binaries.
```
